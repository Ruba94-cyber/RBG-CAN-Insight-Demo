VERSION "Synthetic RBG CAN Insight demo"

BU_: DemoECU DemoBody DemoNode

BO_ 256 EngineData: 8 DemoECU
 SG_ CoolantTemperature : 0|8@1+ (1,-40) [-40|200] "degC" DemoNode
 SG_ EngineLoad : 8|8@1+ (0.5,0) [0|100] "%" DemoNode

BO_ 512 VehicleData: 8 DemoBody
 SG_ VehicleSpeed : 0|16@1+ (0.01,0) [0|250] "km/h" DemoNode

CM_ "Artificial definitions for demonstration only. Not derived from a vehicle or manufacturer.";
